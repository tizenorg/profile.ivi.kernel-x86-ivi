## drivers/gpu/drm/ipvr/Kconfig
```kconfig
config DRM_IPVR
       tristate "IPVR video decode driver"
       depends on DRM
       select SHMEM
       select TMPFS
       default m
       help
         Choose this option if you want to enable accelerated video decode with VED hardware.
		 Currently support VP8 decoding on valleyview.
```

## drivers/media/pci/v2g_bridge/Kconfig
```kconfig
config V2G_BRIDGE
	tristate "Intel V2G_BRIDGE Kernel Module Driver"
	depends on X86 && DRM && PCI && MEDIA_USB_SUPPORT
	---help---
	  Choose this option if enable the fast camera feature.
	  v2g_bridge.enable and v2g_bridge.debug options should
	  be enabled in kernel command line to enable/disable the
	  feature.
	  To compile this driver as a module, choose M here: the
	  module will be called v2g_bridge.

config V2G_BRIDGE_DEBUG
	bool "Debug"
	depends on V2G_BRIDGE
	---help---
	  Say Y here if you want the v2g bridge to produce a bunch of debug
	  messages to the system log.  Select this if you are having a
	  problem with early camera and want to see more of what is going on.
	  Used by developers.
```
